## config/west.yml
```yaml
manifest:
  remotes:
    - name: zmkfirmware
      url-base: https://github.com/zmkfirmware
    - name: eyelash
      url-base: https://github.com/a741725193
    - name: englmaxi
      url-base: https://github.com/englmaxi
    - name: mctechnology17
      url-base: https://github.com/mctechnology17
    - name: badjeff
      url-base: https://github.com/badjeff
  projects:
    - name: zmk
      remote: zmkfirmware
      revision: main
      import: app/west.yml
    - name: zmk-pmw3610-driver
      remote: badjeff
      revision: main
    - name: zmk-nice-oled
      remote: mctechnology17
      revision: main
    - name: zmk-board-eyelash
      remote: eyelash
      revision: main
    - name: zmk-dongle-display
      remote: englmaxi
      revision: v0.3
  self:
    path: config
```

## modu-module/boards/minewsemi/ms88sf3/Kconfig.ms88sf3
```kconfig
# Copyright (c) 2026 EKS Inc.
# Created by Ryu.
# SPDX-License-Identifier: LicenseRef-EKS-NonCommercial-1.0

config BOARD_MS88SF3
    select SOC_NRF52840_QIAA
    select HAS_BOOTLOADER_ADAFRUIT_NRF52
```

## modu-module/boards/shields/modu/Kconfig.defconfig
```kconfig
# Copyright (c) 2026 EKS Inc.
# Created by Ryu.
# SPDX-License-Identifier: LicenseRef-EKS-NonCommercial-1.0

if SHIELD_MODU_LEFT || SHIELD_MODU_DONGLE

config ZMK_KEYBOARD_NAME
    default "Modu"

config ZMK_SPLIT_ROLE_CENTRAL
    default y

endif

if SHIELD_MODU_LEFT || SHIELD_MODU_RIGHT || SHIELD_MODU_PERIPHERAL_LEFT || SHIELD_MODU_DONGLE

config ZMK_SPLIT
    default y

endif
```

## modu-module/boards/shields/modu/Kconfig.shield
```kconfig
# Copyright (c) 2026 EKS Inc.
# Created by Ryu.
# SPDX-License-Identifier: LicenseRef-EKS-NonCommercial-1.0

config SHIELD_MODU_LEFT
    def_bool $(shields_list_contains,modu_left)

config SHIELD_MODU_RIGHT
    def_bool $(shields_list_contains,modu_right)

config SHIELD_MODU_PERIPHERAL_LEFT
    def_bool $(shields_list_contains,modu_peripheral_left)

config SHIELD_MODU_DONGLE
    def_bool $(shields_list_contains,modu_dongle)
```
